## services/dynamodb/Kconfig
```kconfig
# Copyright (c) 2026 Clark Rawlins
# SPDX-License-Identifier: Apache-2.0

# The DynamoDB-compatible service module (services/dynamodb/,
# .kiro/specs/dynamodb-compatible-api/). Sourced from the top-level
# Kconfig's "Service Modules" menu.

config DYNAMODB
	bool "DynamoDB-compatible API (tables, items, indexes, streams)"
	default n
	depends on OPENSSL
	help
	  Builds the services/dynamodb/ module: a DynamoDB-compatible service
	  that unmodified AWS SDKs, the AWS CLI, KCL, the DynamoDB lock client
	  and the Streams Kinesis Adapter can point --endpoint-url at. Items
	  live in the persistent-state-machine kv_engine: the in-memory engine
	  is always built, and RocksDB is used where that spec's engine is on.

	  So far the module holds the pinned botocore models of DynamoDB and
	  DynamoDB Streams, their generated shape tables for the core AWS JSON
	  codec (include/raft/aws_json_protocol.hpp), the operation coverage
	  test and the recorded client wire evidence (task 1). The codecs,
	  state machines, front end and dynamodb_gateway_node follow.

	  OpenSSL is needed for SigV4 (the core sigv4_verifier). It uses
	  IAM's core headers but not the IAM module. Off by default like every
	  new module (services/README.md). See
	  .kiro/specs/dynamodb-compatible-api/.

config DYNAMODB_GATEWAY_IAM
	bool "IAM authentication in dynamodb_gateway_node"
	default y
	depends on DYNAMODB && IAM
	help
	  Builds dynamodb_gateway_node with an embedded read replica of the
	  IAM Raft group and IAM's authorizer, so KYTHIRA_DYNAMODB_AUTH=iam or
	  both authenticates and authorizes requests against Kythira IAM with
	  no network call. Configured by the KYTHIRA_IAM_* variables. The
	  DynamoDB module itself never includes IAM: only the daemon's
	  composition root does. See .kiro/specs/dynamodb-compatible-api/
	  task 28.
```

## services/iam/Kconfig
```kconfig
# Copyright (c) 2026 Clark Rawlins
# SPDX-License-Identifier: Apache-2.0

# The IAM module (services/iam/, .kiro/specs/iam-compatible-auth/).
# Sourced from the top-level Kconfig's "Service Modules" menu.

config IAM
	bool "IAM-compatible authentication and authorization service"
	default n
	depends on OPENSSL
	help
	  Builds the services/iam/ module: an AWS IAM-compatible service
	  (users, groups, roles, managed and inline policies, access keys,
	  STS) hosted by its own Raft group, and the policy evaluator that
	  front ends such as the Redis gateway embed to authorize requests
	  locally. So far the module holds the policy parser and matchers
	  (task 10) and their tests; the state machine, evaluator, daemon and
	  Query API follow. OpenSSL is needed for the access-key sealing and
	  SigV4 the later tasks add. Off by default like every new module
	  (services/README.md). See .kiro/specs/iam-compatible-auth/.
```

## services/kinesis/Kconfig
```kconfig
# Copyright (c) 2026 Clark Rawlins
# SPDX-License-Identifier: Apache-2.0

# The Kinesis Data Streams-compatible service (services/kinesis/,
# .kiro/specs/kinesis-compatible-streams/). Sourced from the top-level
# Kconfig's "Service Modules" menu.

config KINESIS
	bool "Kinesis Data Streams-compatible streaming service"
	default n
	depends on OPENSSL
	help
	  Builds the services/kinesis/ module: a Kinesis Data Streams-
	  compatible service that unmodified AWS SDKs, the AWS CLI, KPL and
	  KCL can point at, with streams of shards stored as routing keys in
	  Kythira's Raft groups and record bytes in the core record segment
	  store. So far the module holds the pinned botocore model, the
	  generated operation table, the coverage check and the
	  kinesis_gateway_node placeholder (task 1); the front end, stream
	  state machine and data plane follow. It needs IAM's core SigV4 and
	  authorizer headers, not the IAM module. OpenSSL is needed for
	  SigV4, segment digests and iterator tokens. Off by default like
	  every new module (services/README.md). See
	  .kiro/specs/kinesis-compatible-streams/.

config KINESIS_GATEWAY_IAM
	bool "IAM authentication in kinesis_gateway_node"
	default y
	depends on KINESIS && IAM
	help
	  Builds kinesis_gateway_node with an embedded read replica of the
	  IAM Raft group and IAM's authorizer, so KINESIS_AUTH=iam or both
	  authenticates and authorizes requests against Kythira IAM with no
	  network call. Configured by the KYTHIRA_IAM_* variables. The
	  Kinesis module itself never includes IAM: only the daemon's
	  composition root does. See .kiro/specs/dynamodb-compatible-api/
	  task 28.
```

## services/ledger/Kconfig
```kconfig
# Copyright (c) 2026 Clark Rawlins
# SPDX-License-Identifier: Apache-2.0

# The verifiable ledger module (services/ledger/,
# .kiro/specs/verifiable-ledger/). Sourced from the top-level Kconfig's
# "Service Modules" menu.

config LEDGER
	bool "Verifiable ledger (tamper-evident journal, digests and proofs)"
	default n
	depends on ION_SERIALIZER && OPENSSL
	help
	  Builds the services/ledger/ module: ledgers of Ion documents whose
	  every committed change is a block in a SHA-256 hash-chained journal,
	  with digests, Merkle proofs, document history and optimistic
	  transactions, each ledger served by one Raft group on a persistent
	  state machine. So far the module holds the Ion hash, the `dot`
	  combiner and the Merkle accumulator (task 2) and the ledger_node
	  placeholder; the state machine, API and daemon follow.

	  Needs ion-c (CONFIG_ION_SERIALIZER, the opt-in `ion` vcpkg feature)
	  for documents and the Ion hash, and OpenSSL for SHA-256. The engine
	  is the persistent-state-machine kv_engine: the in-memory engine is
	  always built, and RocksDB is used where that spec's engine is on.
	  Off by default like every new module (services/README.md). See
	  .kiro/specs/verifiable-ledger/.
```

## services/redis/Kconfig
```kconfig
# Copyright (c) 2026 Clark Rawlins
# SPDX-License-Identifier: Apache-2.0

# The Redis gateway module (services/redis/, .kiro/specs/redis-gateway-module/).
# Sourced from the top-level Kconfig, where these symbols used to be, so the
# symbol order and the generated autoconf header are unchanged.

config REDIS_GATEWAY
	bool "Redis-compatible KV gateway over multi_raft (sccache's redis backend)"
	default y
	depends on OPENSSL
	help
	  Builds kythira/redis/redis_gateway.hpp (services/redis/), the
	  redis_gateway_node daemon and their tests: a RESP2/RESP3 front end
	  over the multi_raft sharding layer scoped to exactly the command
	  closure sccache's `redis` backend (via OpenDAL / redis-rs) puts on
	  the wire -- GET, SET, SETEX, DEL, EXISTS, STRLEN, GETRANGE, PING,
	  AUTH, HELLO, SELECT and CLIENT SETINFO -- plus a splittable
	  replicated KV state machine, ACL with PBKDF2-SHA256 secrets, one-hop
	  leader forwarding and TLS/mTLS. Needs nothing beyond what the tree
	  already requires (Boost.Asio, OpenSSL), so the symbol exists to keep
	  the feature's targets out of a build that does not want them, not to
	  gate a dependency. See .kiro/specs/redis-compatible-kv/.

config REDIS_GATEWAY_TRANSACTIONS
	bool "Cross-shard transactions in redis_gateway_node (MSET, MULTI/EXEC)"
	default n
	depends on REDIS_GATEWAY
	help
	  Builds redis_gateway_node with its KV state machine wrapped in
	  transactional_state_machine, so KYTHIRA_REDIS_TRANSACTIONS=on can
	  run MSET, multi-key DEL, MGET and MULTI/EXEC/DISCARD as cross-shard
	  transactions. The wrapper changes the snapshot format, so every
	  node of a cluster must be built the same way; plain commands are
	  unchanged on the wire. See .kiro/specs/multi-raft-transactions/
	  task 9 and doc/redis-gateway.md.

config REDIS_GATEWAY_SNAPSHOT_ISOLATION
	bool "Snapshot isolation in redis_gateway_node (versioned KV, oracle)"
	default n
	depends on REDIS_GATEWAY_TRANSACTIONS
	help
	  Builds redis_gateway_node's KV state machine multi-versioned
	  (redis_kv_mvcc_state_machine under mvcc::on), with a timestamp
	  oracle group on every node, so the snapshot and serializable
	  isolation levels and WATCH/UNWATCH are accepted, and MGET reads one
	  point in time across shards. Every write then takes two Raft rounds
	  and an oracle timestamp, and the snapshot format changes again, so
	  every node of a cluster must be built the same way. See
	  .kiro/specs/multi-raft-transactions/ task 14 and
	  doc/redis-gateway.md.

config REDIS_GATEWAY_IAM
	bool "IAM authentication in redis_gateway_node (AUTH with IAM tokens)"
	default y
	depends on REDIS_GATEWAY && IAM
	help
	  Builds redis_gateway_node with the IAM module's credential
	  verifier: an ACL user marked auth=iam or auth=both can AUTH with
	  an ElastiCache-style IAM auth token, checked against an embedded
	  read replica of the IAM Raft group, so an AUTH makes no network
	  call. Configured by the KYTHIRA_IAM_* environment variables;
	  without this option the daemon reads none of them and has no
	  IAM code. The Redis module itself never
	  includes IAM: only the daemon's composition root does. See
	  .kiro/specs/iam-compatible-auth/ task 21.

config REDIS_GATEWAY_ENGINE
	bool "Persistent engine storage in redis_gateway_node (KYTHIRA_CACHE_PERSISTENCE=engine)"
	default n
	depends on REDIS_GATEWAY && ENGINE_ROCKSDB && !REDIS_GATEWAY_SNAPSHOT_ISOLATION
	help
	  Lets redis_gateway_node keep its values in a RocksDB database per
	  node (persistent_kv_state_machine) when started with
	  KYTHIRA_CACHE_PERSISTENCE=engine. A group's state is then bounded
	  by disk, not memory, a restart reloads nothing, and a follower that
	  falls behind is caught up by streaming checkpoint files. The data
	  directory holds engine/, raft/<group> and snapshots/, and
	  KYTHIRA_CACHE_MAX_DISK_BYTES and the free-space floors apply as in
	  file mode. With REDIS_GATEWAY_TRANSACTIONS the transaction state
	  lives in the database too. See .kiro/specs/persistent-state-machine/
	  task 7 and doc/persistent_state_machines.md.
```
